## layers/meta-balena-phytec/conf/layer.conf
```bitbake
BBPATH .= ":${LAYERDIR}"

BBFILES += "${LAYERDIR}/recipes-*/*/*.bb \
            ${LAYERDIR}/recipes-*/*/*.bbappend"

BBFILE_COLLECTIONS += "balena-phytec"
BBFILE_PATTERN_balena-phytec = "^${LAYERDIR}/"
BBFILE_PRIORITY_balena-phytec = "1337"

LAYERDEPENDS_balena-phytec = "core"
LAYERDEPENDS_balena-phytec = "openembedded-layer"
LAYERDEPENDS_balena-phytec = "networking-layer"
LAYERDEPENDS_balena-phytec = "balena-common"
LAYERDEPENDS_balena-phytec = "balena-kirkstone"
LAYERDEPENDS_balena-phytec = "meta-ti-bsp"
LAYERDEPENDS_balena-phytec = "phytec"

LAYERSERIES_COMPAT_balena-phytec = "kirkstone"

# Balena requires that kernel-image-initramfs is deployed instead kernel-image-image.
MACHINE_ESSENTIAL_EXTRA_RDEPENDS:remove:phyboard-lyra-am62xx-2 = " kernel-image-image"
MACHINE_ESSENTIAL_EXTRA_RDEPENDS:append:phyboard-lyra-am62xx-2 = " kernel-image-initramfs"

TI_COMMON_DEPLOY = "${DEPLOY_DIR}"
```
